#include "ST7735.h"

// BITMAP structures
// Change to #ENUM?
#define BMP_ATTR_NO_INVISIBLE   0x80
#define BMP_ATTR_DRAW_DIR_MASK  0x03

#define BMP_ATTR_DRAW_DIR_UP    0x00
#define BMP_ATTR_DRAW_DIR_CW    0x01
#define BMP_ATTR_DRAW_DIR_DN    0x02
#define BMP_ATTR_DRAW_DIR_CCW   0x03

enum class BmpDir
{
  Up  = 0x00,
  Cw  = 0x01,
  Dn  = 0x02,
  Ccw = 0x03
};

// START CLASS BITMAP ======================================================================================= 

class Bitmap 
{ 
  private: 
    unsigned char width;
    unsigned char height;
    unsigned char invColor;
    unsigned char attributes;
    const unsigned char *ptr;

  public: 
    Bitmap(const unsigned char *Ptr, unsigned char Width, unsigned char Height, BmpDir Dir, unsigned char InvColor, bool HasInv);
    Bitmap(const Bitmap& copy); //copy constructor
    Bitmap& operator=(const Bitmap& copy); //copy assignment
    ~Bitmap();
    
    void Draw(signed char left, signed char top);
}; 

Bitmap::Bitmap(const unsigned char *Ptr, unsigned char Width, unsigned char Height, BmpDir Dir, unsigned char InvColor, bool HasInv)
{
  ptr = Ptr;
  if (ptr == NULL)
  {
    width = 0;
    height = 0;
  }
  else
  {
    width = Width;
    height = Height;
    invColor = InvColor;
    attributes = (unsigned char)Dir;
    if (!HasInv) attributes |= BMP_ATTR_NO_INVISIBLE;
  }
}

Bitmap::Bitmap(const Bitmap& copy)
{
  ptr = copy.ptr;
  width = copy.width;
  height = copy.height;
  attributes = copy.attributes;
  invColor = copy.invColor;
}

Bitmap& Bitmap::operator=(const Bitmap& copy)
{
  ptr = copy.ptr;
  width = copy.width;
  height = copy.height;
  attributes = copy.attributes;
  invColor = copy.invColor;
}

Bitmap::~Bitmap()
{
  ptr == NULL;
  width = 0;
  height = 0;
}

void Bitmap::Draw(signed char left, signed char top)
{
  signed char X, Y;
  unsigned char I, J;  
  unsigned char color8;
  BmpDir dir;

  dir = (BmpDir)(attributes & (unsigned char)(BmpDir::Ccw));
  
  for (I = 0; I < width; I++)
  {
    X = left + I;
    if ((X >= 0) && (X < COMP_X))
    {
      for (J = 0; J < height; J++)  
      {
        Y = top + J;
        if ((Y >= 0) && (Y < COMP_Y))
        {
          switch(dir)
          {
            case BmpDir::Up:
              color8 = pgm_read_byte_near(ptr + (I * height) + J);
            break;

            case BmpDir::Cw:
              color8 = pgm_read_byte_near(ptr + (J * height) + (width - 1 - I));
            break;

            case BmpDir::Dn:
              color8 = pgm_read_byte_near(ptr + ((width - 1 - I) * height) + (height - 1 - J));
            break;

            case BmpDir::Ccw:
              color8 = pgm_read_byte_near(ptr + ((height - 1 - J) * height) + I);
            break;
          }
          if ((color8 != invColor) || ((attributes & BMP_ATTR_NO_INVISIBLE) == BMP_ATTR_NO_INVISIBLE))
          {
            drawPixel(X, Y, color8); 
          }
        }
      }
    }
  }
}

// END CLASS BITMAP ======================================================================================= 

// Mountain background bitmap
const static unsigned char mountain_bulk[204][64] PROGMEM = {
  {0x96, 0xB7, 0xB6, 0x96, 0xB6, 0xB7, 0xDB, 0xDB, 0xB6, 0xB6, 0xB6, 0xDB, 0xDB,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 0x97, 
    0x4A, 0x4A, 0x4E, 0x72, 0x93, 0x6E, 0x6E, 0x25, 0x01, 0x01, 0x01, 0x01, 0x01, 0x25, 0x25, 0x25, 0x25, 0x05, 0x25, 0x25, 0x01, 0x01, 0x01, 0x01, 0x01, 0x01, 0x01, 0x25, 0x01},
  {0xB7, 0xB7, 0xB6, 0xB6, 0x96, 0xB6, 0xB7, 0xDB, 0xB6, 0xB6, 0xB6, 0xDB, 0xDB,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 0xB7, 
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    0x4A, 0x4A, 0x4E, 0x72, 0x93, 0x6E, 0x6E, 0x25, 0x01, 0x01, 0x01, 0x01, 0x01, 0x25, 0x25, 0x25, 0x25, 0x05, 0x25, 0x25, 0x01, 0x01, 0x01, 0x01, 0x01, 0x01, 0x01, 0x25, 0x01}};
